## Kconfig
```kconfig
# SPDX-License-Identifier: MIT
DT_COMPAT_ZMK_INPUT_PROCESSOR_SUPPRESS := zmk,input-processor-suppress
config ZMK_INPUT_SUPPRESS
    bool
    default $(dt_compat_enabled,$(DT_COMPAT_ZMK_INPUT_PROCESSOR_SUPPRESS))
    depends on ZMK_POINTING
    depends on !ZMK_SPLIT || ZMK_SPLIT_ROLE_CENTRAL
    depends on INPUT_MODE_THREAD

config ZMK_INPUT_SUPPRESS_MAX_SOURCES
    int "Input Suppress global listener index slots (0 = automatic)"
    default 0
    range 0 256
    depends on ZMK_INPUT_SUPPRESS
    help
      Automatic allocation retains one history for each enabled input listener,
      with a minimum of one. A positive value allocates global listener indices
      0 through N-1 without remapping them. Every listener route referencing an
      enabled Input Suppress device must fit; direct callers must use the same
      bound. Recheck compiled indices and callers before reducing this value.
```

## dts/bindings/zmk,input-processor-suppress.yaml
```yaml
# SPDX-License-Identifier: MIT
description: Final source-button and residual-ABS filter; param1 is a suppression mask
compatible: "zmk,input-processor-suppress"
include: ip_one_param.yaml
```

## tests/integration/module/Kconfig
```kconfig
config INPUT_SUPPRESS_NATIVE_TEST
    bool "Exercise final filter through the actual listener and HID"
    depends on ZMK_INPUT_SUPPRESS

config INPUT_SUPPRESS_NATIVE_LOW_SOURCES
    bool "Require the alternate global listener indices 0 and 1"
    depends on INPUT_SUPPRESS_NATIVE_TEST
```
